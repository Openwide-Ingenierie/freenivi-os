## conf/bblayers.conf
```bitbake
# LAYER_CONF_VERSION is increased each time build/conf/bblayers.conf
# changes incompatibly
LCONF_VERSION = "6"
TOPDIR := "${@os.path.dirname(os.path.dirname(d.getVar('FILE', True)))}"

BBPATH = "${TOPDIR}"

BBFILES = ""

BBLAYERS ?= " \
  ${TOPDIR}/src/oe-core/meta \
  ${TOPDIR}/src/meta-intel \
  ${TOPDIR}/src/meta-fsl-arm \
  ${TOPDIR}/src/meta-fsl-arm-extra \
  ${TOPDIR}/src/meta-qt5 \
  ${TOPDIR}/src/meta-freenivi \
  "
```

## conf/local.conf
```bitbake
# CONF_VERSION is increased each time build/conf/ changes incompatibly
CONF_VERSION = "1"

DL_DIR ?= "/home/share/downloads"
SSTATE_MIRRORS ?= "/home/share/sstate-cache"

#INHERIT += "rm_work"

# Which files do we want to parse:
BBMASK = ""

# What kind of images do we want?
IMAGE_FSTYPES_append = " tar.xz"

# Make use of SMP:
#   PARALLEL_MAKE specifies how many concurrent compiler threads are spawned per bitbake process
#   BB_NUMBER_THREADS specifies how many concurrent bitbake tasks will be run
#PARALLEL_MAKE     = "-j8"
BB_NUMBER_THREADS = "8"

DISTRO = "freenivi"

# Don't generate the mirror tarball for SCM repos, the snapshot is enough
BB_GENERATE_MIRROR_TARBALLS = "0"

# Disable build time patch resolution. This would lauch a devshell
# and wait for manual intervention. We disable it.
PATCHRESOLVE = "noop"

EXTRA_IMAGE_FEATURES = "debug-tweaks"
USER_CLASSES ?= "buildstats image-mklibs image-prelink"

BB_DISKMON_DIRS = "\
    STOPTASKS,${TMPDIR},1G,100K \
    STOPTASKS,${DL_DIR},1G,100K \
    STOPTASKS,${SSTATE_DIR},1G,100K \
    ABORT,${TMPDIR},100M,1K \
    ABORT,${DL_DIR},100M,1K \
    ABORT,${SSTATE_DIR},100M,1K"

ACCEPT_FSL_EULA = "1"
LICENSE_FLAGS_WHITELIST = "commercial"

FEED_DEPLOYDIR_BASE_URI = "http://freenivi/ipk"
```
